## bsp/stm32/stm32h7b0-nintendo-game-and-watch/board/Kconfig
```kconfig
menu "Hardware Drivers Config"

config SOC_STM32H7B0VB
    bool
    select SOC_SERIES_STM32H7
    select RT_USING_COMPONENTS_INIT
    select RT_USING_USER_MAIN
    default y

config BOARD_STM32H7B0_NINTENDO
    bool
    default y

menu "Board extended module"

endmenu

menu "Onboard Peripheral Drivers"

endmenu

menu "On-chip Peripheral Drivers"
    config BSP_USING_UART1
    bool "ENABLE UART1 over unused pin."
    select BSP_USING_UART
    default n

    source "../libraries/HAL_Drivers/Kconfig"

endmenu

menu "External Libraries"


endmenu

endmenu
```
